## dts/bindings/input/cirque,pinnacle-common.yaml
```yaml
properties:
  dr-gpios:
    type: phandle-array
    description: Data ready pin for the trackpad
  rotate-90:
    type: boolean
  x-invert:
    type: boolean
  y-invert:
    type: boolean
  sleep:
    type: boolean
  no-secondary-tap:
    type: boolean
  no-taps:
    type: boolean
  sensitivity:
    type: string
    enum:
      - 1x
      - 2x
      - 3x
      - 4x
    description: ADC attenuation (sensitivity) setting.
  x-axis-z-min:
    type: int
    default: 5
  y-axis-z-min:
    type: int
    default: 4
  absolute-mode:
    type: boolean
  abs-rel-divisor:
    type: int
    description: If non zero, uses pad in absmode, but sends relative events (and touch press/release)
    default: 0
  circular-scroll:
    type: boolean
    description: Convert circular movement in the outer pad area to vertical scroll events.
  circular-scroll-invert:
    type: boolean
    description: Invert circular scroll direction.
  circular-scroll-min-radius:
    type: int
    default: 550
    description: Minimum raw distance from pad center required to start a circular scroll touch.
  circular-scroll-active-min-radius:
    type: int
    default: 550
    description: Minimum raw distance from pad center allowed for scrolling after a touch has started in scroll mode.
  circular-scroll-max-radius:
    type: int
    default: 1200
    description: Maximum raw distance from pad center allowed for circular scroll.
  circular-scroll-divisor:
    type: int
    default: 32
    description: Higher values reduce scroll ticks per rotation.
  circular-scroll-center-x:
    type: int
    default: 1024
    description: Raw absolute X coordinate used as the circular scroll center.
  circular-scroll-center-y:
    type: int
    default: 736
    description: Raw absolute Y coordinate used as the circular scroll center.
  absolute-mode-scale-to-width:
    type: int
    default: 1024
    description: Scale reported x values to [0-1024]
  absolute-mode-scale-to-height:
    type: int
    default: 1024
    description: Scale reported y values to [0-1024]
  absolute-mode-clamp-min-x:
    type: int
    default: 128
    description: |
      Specification says that active reporting of absolute position
      is: 128 ≤ X ≤1920 and 64 ≤ Y ≤ 1472, but on my touchpad, I need other values.
  absolute-mode-clamp-max-x:
    type: int
    default: 1920
    description: |
      Specification says that active reporting of absolute position
      is: 128 ≤ X ≤1920 and 64 ≤ Y ≤ 1472, but on my touchpad, I need other values.
  absolute-mode-clamp-min-y:
    type: int
    default: 64
    description: |
      Specification says that active reporting of absolute position
      is: 128 ≤ X ≤1920 and 64 ≤ Y ≤ 1472, but on my touchpad, I need other values.
  absolute-mode-clamp-max-y:
    type: int
    default: 1472
    description: |
      Specification says that active reporting of absolute position
      is: 128 ≤ X ≤1920 and 64 ≤ Y ≤ 1472, but on my touchpad, I need other values.
```
